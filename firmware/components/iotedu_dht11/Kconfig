## firmware/components/iotedu_dht11/Kconfig
```kconfig
menu "IoT.Edu DHT11"

    config IOTEDU_DHT11_PIN
        int "DHT11 data GPIO"
        range 0 27
        default 4
        help
            Single-wire data pin for the DHT11. GPIO4 matches the audited reference firmware.
            GPIO8 is a strapping pin and GPIO9 is the factory-reset button; the workspace
            generator rejects those assignments before configuring the build.

endmenu
```
